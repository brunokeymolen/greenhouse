## main/Kconfig.projbuild
```kconfig
menu "Greenhouse controller"

choice GREENHOUSE_SENSOR_TYPE
    prompt "Humidity/temperature sensor"
    default GREENHOUSE_SENSOR_DHT22
    help
        Both parts share a single-wire protocol and the same driver. The DHT22
        is the better fit for a greenhouse: the DHT11 is rated only 20-90 %RH
        and 0-50 C, and a greenhouse crosses 90 %RH exactly when ventilation is
        wanted.

config GREENHOUSE_SENSOR_DHT11
    bool "DHT11"

config GREENHOUSE_SENSOR_DHT22
    bool "DHT22 / AM2302"

endchoice

config GREENHOUSE_SENSOR_GPIO
    int "Sensor DATA GPIO"
    default 2
    range 0 3
    help
        The ESP-01 header breaks out only GPIO0, GPIO1, GPIO2 and GPIO3.
        GPIO0 drives the relay on the carrier board and GPIO3 is the serial RX
        needed for flashing, so the real choice is GPIO2 or GPIO1.

        GPIO2 (default) keeps the serial console working, which makes every
        later milestone easier to debug. It is high at boot through its pull-up,
        which is what the boot straps require, and a DHT sensor idles high too.

        GPIO1 is the design document's original choice. It works, but it is the
        UART TX pin, so serial logging must be disabled and the web UI becomes
        the only way to see what the firmware is doing.

        Verify with a continuity meter which pin your carrier wires to the relay
        driver before committing. A few carrier variants use GPIO2 rather than
        GPIO0; on those, GPIO2 is not available for the sensor.

config GREENHOUSE_RELAY_GPIO
    int "Relay control GPIO"
    default 0
    range 0 3
    help
        GPIO0 on the common ESP-01 relay carriers. Confirm with a continuity
        meter before wiring a load: a minority of carriers use GPIO2 instead,
        which would collide with the sensor.

        GPIO0 is also the boot strap. It is held high by its pull-up until
        relay_init() runs, so on an active-high carrier the relay is energised
        for the first few hundred milliseconds after power-up. Relay polarity is
        a runtime setting, not a Kconfig one, so it can be flipped from the web
        UI during bring-up.

config GREENHOUSE_SENSOR_POLL_INTERVAL_S
    int "Sensor poll interval, seconds"
    default 5
    range 2 60
    help
        Each reading disables interrupts for roughly 5 ms, so do not poll faster
        than the sensor's own conversion rate allows: one second for a DHT11, two
        for a DHT22.

config GREENHOUSE_SENSOR_STALE_TIMEOUT_S
    int "Seconds without a valid reading before the value is flagged stale"
    default 60
    range 10 600

config GREENHOUSE_AP_PASSWORD
    string "Default SoftAP WPA2 password"
    default "greenhouse"
    help
        The factory password for the device's own access point, used on a fresh
        device and restored by a factory reset. It can be changed at runtime
        from the web UI, which is what a deployed device should use.

        Because this is the value a factory reset returns to, it is what has to
        be printed on the device label or in the documentation: it is the only
        credential someone recovering an unreachable unit can be expected to
        know.

        At least 8 characters, or the access point starts open.

config GREENHOUSE_AP_CHANNEL
    int "SoftAP channel"
    default 1
    range 1 13

config GREENHOUSE_AP_MAX_CONN
    int "Maximum simultaneous AP clients"
    default 4
    range 1 8

config GREENHOUSE_STA_CONNECT_ATTEMPTS
    int "Join attempts before falling back to a recovery access point"
    default 10
    range 3 30
    help
        How many times to try joining the configured network at boot before
        giving up and raising the recovery access point for that boot.

        This counts only the initial join. Once the network has been joined
        successfully, later disconnections reconnect indefinitely instead, so a
        router reboot never demotes a working device.

config GREENHOUSE_RECOVERY_AP_IDLE_S
    int "Seconds before an unused recovery access point restarts the device"
    default 600
    range 60 3600
    help
        If nobody joins the recovery access point within this time, restart and
        try the configured network again. That is what makes a router which was
        merely slow to come back heal without anyone walking out to the
        greenhouse.

        The countdown stops while a client is connected, so the device never
        reboots out from under someone who is halfway through the settings form.

config GREENHOUSE_STA_DOWN_RESTART_S
    int "Seconds disconnected from a known network before restarting"
    default 900
    range 120 7200
    help
        Applies once the configured network has been joined at least once. If it
        stays unreachable for this long, restart: a fresh boot re-runs the join
        attempts and, if the network really is gone for good, ends up in the
        recovery access point where the settings can be corrected.

config GREENHOUSE_FACTORY_RESET_PRESSES
    int "Resets in a row that restore factory defaults"
    default 5
    range 3 10
    help
        The ESP-01 has no spare GPIO for a button and RST cannot be timed in
        firmware, so a factory reset is requested by tapping the reset button
        this many times in quick succession. See main/factory_reset.h.

        Lower values are easier to perform and easier to trigger by accident;
        the risk is a flaky supply producing a burst of resets.

config GREENHOUSE_FACTORY_RESET_WINDOW_S
    int "Seconds a reset may be followed by the next one"
    default 5
    range 2 30
    help
        Each tap has to arrive within this many seconds of the previous boot, or
        the chain is forgotten. Long enough to be comfortable, short enough that
        unrelated resets over the device's life never accumulate.

config GREENHOUSE_FACTORY_RESET_CLICK
    bool "Confirm a factory reset by clicking the relay"
    default y
    help
        Pulse the relay three times after restoring defaults. The relay is the
        only output this board has, and a headless device that has just
        discarded the owner's settings should say so audibly.

        Turn this off if the relay switches something that must not be touched
        even briefly.

config GREENHOUSE_HISTORY_SAMPLES
    int "Samples kept for the history chart"
    default 2016
    range 60 4032
    help
        Each sample costs 3 bytes of static RAM. 2016 samples at the default
        300 s interval is 7 days and about 6 kB.

        History lives in RAM only and is lost on reboot. Persisting it would
        mean writing flash every interval, which wears the part out on a device
        meant to run for whole seasons.

config GREENHOUSE_HISTORY_INTERVAL_S
    int "Seconds per history sample"
    default 300
    range 30 3600
    help
        Sensor polls are averaged into buckets of this length. A bucket with no
        valid reading is stored as a gap rather than a zero.

config GREENHOUSE_DIAG_WIFI_PROBES
    bool "Diagnostic: log Wi-Fi probe requests"
    default n
    help
        Unmasks WIFI_EVENT_AP_PROBEREQRECVED and logs the MAC and RSSI of every
        probe request, rate limited.

        Use it when a client can see the network but cannot join. Probes logged
        means the client's RF reaches the device and the failure is in
        authentication; no probes at all means the client never got that far.

        Noisy: every nearby device probes. Leave off in normal builds.

config GREENHOUSE_DIAG_AP_OPEN
    bool "Diagnostic: run the access point with no password"
    default n
    help
        Starts the SoftAP open instead of WPA2. Splits an authentication problem
        from an RF or client problem: if an open network joins fine, the fault is
        in the PSK path, not the radio.

        Obviously do not ship this.

config GREENHOUSE_DIAG_NO_WIFI
    bool "Diagnostic: start without Wi-Fi"
    default n
    help
        Skips the access point and web server, leaving only the sensor task.

        Use this to tell a supply or RF problem apart from a bad sensor. The
        sensor's humidity element is far more sensitive to a sagging 3.3 V rail
        than its temperature element, so readings that steady up with the radio
        off point at power, not at the sensor.

endmenu
```
